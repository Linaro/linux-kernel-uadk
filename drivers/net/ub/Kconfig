## drivers/net/ub/Kconfig
```kconfig
# SPDX-License-Identifier: GPL-2.0+
#
# UB network configuration
#

menuconfig UB_NET
	bool "UB network driver support"
	depends on NET
	depends on ARM64
	default n
	help
	  If you have a network (UB) card belonging to this class, say Y.

	  UB is a new interconnection protocol that defines its own physical layer,
	  data link layer, and network layer.
	  This option includes the data link layer and all UB network device drivers.
	  On the otherside, it can also be used with ethernet link for layer 2,
	  which still integrates with the TCP/IP protocol stack.

if UB_NET

config UB_UBL
	default n
	tristate "UB link support"
	help
	  This enables UB link support which is
	  used to replace traditional ethernet layer.
	  Say 'Y' or 'm' if your device works
	  in UB mode.

config UB_UNIC
	tristate "NIC based on UB devices"
	default n
	depends on UB_UBASE
	help
	  This option is used to enable the networking capabilities of the
	  UB device and integrate with the TCP/IP protocol stack.
	  This module depends upon UB_UBASE driver to access the ub devices
	  and their associated operations. For UB devices, in addition to the
	  ubase driver, it also relies on the ubl driver.

config UB_UNIC_UBL
	bool "Hisilicon UNIC UB link support"
	default n
	depends on UB_UBL
	depends on UB_UNIC
	help
	  This option enables support for UB Link (UBL) in the Hisilicon
	  UNIC network driver. UB link is used to replace traditional
	  ethernet layer in the UB devices. When enable UB_UNIC_UBL config,
	  UNIC driver will use the interfaces defined by UBL.

	  To use this feature, you must have both the UB_UBL and UB_UNIC
	  options enabled.

	  If you are unsure whether you need this functionality, it is
	  recommended to leave it disabled to avoid unnecessary kernel bloat.

config UB_UNIC_DCB
	bool "Hisilicon UNIC Data Center Bridge Support"
	default n
	depends on DCB
	depends on UB_UNIC
	help
	  This option enables support for Data Center Bridging (DCB) in the
	  Hisilicon UNIC network driver. DCB allows for the configuration of
	  network traffic classes and priorities, enhancing network performance
	  in data center environments.

	  To use this feature, you must have both the DCB and UB_UNIC options enabled.

	  If you are unsure whether you need this functionality, it is
	  recommended to leave it disabled to avoid unnecessary kernel bloat.

endif #UB_NET
```

## drivers/ub/Kconfig
```kconfig
# SPDX-License-Identifier: GPL-2.0+
#
# UnifiedBus configuration
#

menuconfig UB
       bool "UB (UnifiedBus) support"
       depends on ARM64
       default n
       help
         Support for UB.
         If you have a hardware that support UB protocol,
         Say y here. By Default this option is closed.

if UB
source "drivers/ub/ubus/Kconfig"
source "drivers/ub/ubfi/Kconfig"
endif # UB
```

## drivers/ub/cdma/Kconfig
```kconfig
# SPDX-License-Identifier: GPL-2.0+
menuconfig UB_CDMA
	default n
	tristate "cdma driver"
	depends on UB_UBASE && UB_UMMU_CORE
	help
	   This option enables support for CDMA drivers. The CDMA driver facilitates
	   the creation and destruction of CDMA devices, as well as the creation of
	   resources within CDMA devices to perform DMA read/write tasks and retrieve
	   the completion status of executed tasks.
```

## drivers/ub/ubase/Kconfig
```kconfig
# SPDX-License-Identifier: GPL-2.0+
#
# ubase configuration
#

menuconfig UB_UBASE
		default n
		tristate "UBASE support"
		depends on UB_UBUS_BUS && UB_UBUS_USI
		depends on UB_UMMU_CORE_DRIVER
		help
		  This option enables support for the ubase module of Unifiedbus,
		  including support for getting resource and create auxiliary bus
		  for upper Unifiedbus modules like unic, udma and cdma.
		  Say 'Y' here if you want to enable Unifiedbus upper module.
```

## drivers/ub/ubfi/Kconfig
```kconfig
# SPDX-License-Identifier: GPL-2.0+
#
# UnifiedBus firmware interface driver configuration
#

if UB_UBUS

config UB_UBFI
	tristate "UnifiedBus firmware interface driver"
	depends on UB_UBUS
	default n
	help
	  This option support for UnifiedBus firmware interface driver.
	  If you have ub function say y and it will be accessible from
	  within Linux. To compile this driver as a module, choose M here.
	  Say 'M' here unless you know what you are doing

config UB_UBRT_PLAT_DEV
	bool "Enable UBRT platform device support"
	depends on UB_UBUS
	default n
	help
	  This option enables the configuration of platform devices related to
	  the ub ubrt table.
	  If enabled, the UBRT-related platform device will obtain the
	  interrupt ID from the ubrt table instead of the IORT table.
	  The obtained interrupt ID will be used for the MSI interrupt of the
	  UBRT-related platform device.

endif
```

## drivers/ub/ubus/Kconfig
```kconfig
# SPDX-License-Identifier: GPL-2.0+
#
# UB bus driver configuration
#

menuconfig UB_UBUS
	default n
	bool "UBUS support"
	depends on UB
	help
	  This option enables support for UB bus device management
	  functionality, providing fundamental capabilities such as
	  UB bus registration, device registration, and driver registration.
	  It configures and enables devices, offering device capabilities
	  to the upper layers.
	  Say 'Y' here unless you know what you are doing.

if UB_UBUS

config UB_UBUS_BUS
	default n
	tristate "UB Bus Driver Modular Section"
	depends on UB_UBUS
	help
	  This option enables the modular part of the UB bus driver,
	  which works in conjunction with the built-in part to implement
	  the UB bus device management functionality.
	  Say 'M' here unless you know what you are doing.

config UB_UBUS_USI
	default n
	bool "UBUS Message Signaled Interrupts (USI)"
	depends on UB_UBUS
	select GENERIC_MSI_IRQ
	help
		This allows device drivers to enable MSI (Message Signaled
		Interrupts).  Message Signaled Interrupts enable a device to
		generate an interrupt using an inbound Memory Write on its
		UnifiedBus instead of asserting a device IRQ pin.If you
		don't know what to do here, say Y.

source "drivers/ub/ubus/vendor/Kconfig"

endif
```

## drivers/ub/ubus/vendor/Kconfig
```kconfig
# SPDX-License-Identifier: GPL-2.0+

menu "UB vendor drivers"
	depends on UB_UBUS

config UB_HISI_UBUS
	tristate "hisilicon ubus"
	depends on UB_UBUS_BUS
	depends on UB_UBUS_USI
	default n
	help
	  This option enables the modular part of the hisilicon ubus driver.
	  If you choose the ubus function provided by HiSilicon say y
	  and it will be accessible from within Linux.
	  To compile this driver as a module, choose M here.
	  Say 'M' here unless you know what you are doing

endmenu
```

## drivers/ub/urma/hw/udma/Kconfig
```kconfig
# SPDX-License-Identifier: GPL-2.0+
# Copyright(c) 2025 HiSilicon Technologies CO., Ltd. All rights reserved.

menuconfig UB_UDMA
	default n
	tristate "UB UDMA Driver"
	depends on UB_UBASE && UB_URMA && UB_UMMU_CORE
	help
	  UDMA driver support for Hisilicon UBUS engine
	  in Hisilicon SoC. To compile this driver,
	  choose Y here: if UB_UDMA is m, this module
	  will be called udma.
```

## drivers/vfio/ubus/Kconfig
```kconfig
# SPDX-License-Identifier: GPL-2.0+
menu "VFIO support for UBUS devices"
	depends on UB_UBUS && MMU

config VFIO_UB
	tristate "Generic VFIO support for any UBUS device"
	select VFIO_VIRQFD
	select IRQ_BYPASS_MANAGER
	help
	  Support for the generic UBUS VFIO bus driver which can connect any
	  UBUS device to the VFIO framework.

	  If you don't know what to do here, say N.

endmenu
```
